## drivers/input/touchscreen/chipone_tddi_fhd_mmi/Kconfig
```kconfig
# SPDX-License-Identifier: GPL-2.0-only
config TOUCHSCREEN_CHIPONE_FHD_MMI
	tristate "Motorola chipone_tddi_fhd_mmi touchscreen"
	depends on SPI

config INPUT_CHIPONE_0FLASH_MMI_ENABLE_DOUBLE_TAP
	bool "Chipone double tap"
	depends on TOUCHSCREEN_CHIPONE_FHD_MMI && SENSORS_CLASS

config INPUT_CHIPONE_0FLASH_MMI_NOTIFY_TOUCH_STATE
	bool "Chipone touch state notification"
	depends on TOUCHSCREEN_CHIPONE_FHD_MMI && SENSORS_CLASS

config INPUT_CHIPONE_PANEL_NOTIFICATIONS
	bool "Chipone panel notifications"
	depends on TOUCHSCREEN_CHIPONE_FHD_MMI && SENSORS_CLASS
```

## drivers/input/touchscreen/ili9882_mmi/Kconfig
```kconfig
# SPDX-License-Identifier: GPL-2.0-only
config TOUCHSCREEN_ILI9882_MMI
	tristate "Motorola ili9882_mmi touchscreen"
	depends on SPI

config INPUT_ILI_0FLASH_MMI_ENABLE_DOUBLE_TAP
	bool "Ilitek double tap"
	depends on TOUCHSCREEN_ILI9882_MMI && SENSORS_CLASS

config INPUT_ILI_0FLASH_MMI_NOTIFY_TOUCH_STATE
	bool "Ilitek touch state notification"
	depends on TOUCHSCREEN_ILI9882_MMI && SENSORS_CLASS

config INPUT_ILI_PANEL_NOTIFICATIONS
	bool "Ilitek panel notifications"
	depends on TOUCHSCREEN_ILI9882_MMI && SENSORS_CLASS
```
